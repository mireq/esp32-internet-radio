## main/Kconfig.projbuild
```kconfig
menu "Internet Radio Player"


menu "Wifi Configuration"

config WIFI_SSID
	string "Wifi SSID"
	help
		Name (SSID) if wifi network


config WIFI_PASSWORD
	string "Wifi Password"
	help
		Password for WPA/WPA2.

config NETWORK_STATIC_CONFIGURATION
	bool "Static IP address"
	help
		Set static IP address.

config IPV4_ADDRESS
	string "IP address"
	default "192.168.1.250"
	depends on NETWORK_STATIC_CONFIGURATION
	help
		IPv4 address

config IPV4_MASK
	string "IP mask"
	default "255.255.255.0"
	depends on NETWORK_STATIC_CONFIGURATION
	help
		IPv4 mask

config IPV4_GATEWAY
	string "IP gateway"
	default "192.168.1.1"
	depends on NETWORK_STATIC_CONFIGURATION
	help
		IPv4 gateway

config IPV4_PRIMARY_DNS
	string "Primary DNS server"
	default "192.168.1.1"
	depends on NETWORK_STATIC_CONFIGURATION
	help
		IPv4 address of primary DNS server

config IPV4_SECONDARY_DNS
	string "Secondary DNS server"
	default "192.168.1.1"
	depends on NETWORK_STATIC_CONFIGURATION
	help
		IPv4 address of secondary DNS server

endmenu

menu "Playlist"

config PLAYLIST_DEFAULT_STATION_NAME
	string "Default station name"
	default "Test radio"
	help
		Descriptive name of default station

config PLAYLIST_DEFAULT_STATION_URL
	string "Stream url of default station"
	default ""
	help
		URL of stream e.g. http://ice1.somafm.com/illstreet-128-mp3

endmenu

menu "Control interface"

config HTTP_CONTROL
	bool "Build http control"
	default y
	help
		Control interface using http

config HTTP_CONTROL_PORT
	int "HTTP control port"
	range 0 65535
	default "80"
	depends on HTTP_CONTROL
	help
		Port for HTTP control interface

config HTTP_WEBINTERFACE_URL
	string "URL of web interface"
	default "http://localhost:8000/"
	depends on HTTP_CONTROL
	help
		URL of uploaded webinterface directory

endmenu

config BUILD_SIMULATOR
	bool "Build simulator"
	help
		Build simulator using FreeRTOS posix simulator.


menu "Debug"

config DEBUG_PRINT_TASK_STATISTICS
	bool "Print task statistics"
	default n
	depends on FREERTOS_USE_TRACE_FACILITY
	help
		Print task name, priority, run time and free stack size every second.

endmenu

endmenu
```

## sdkconfig.defaults
```kconfig
CONFIG_ESPTOOLPY_BAUD_2MB=y
CONFIG_ESPTOOLPY_FLASHSIZE="4MB"
CONFIG_PARTITION_TABLE_CUSTOM=y
CONFIG_PARTITION_TABLE_CUSTOM_FILENAME="partitions.csv"
CONFIG_PARTITION_TABLE_CUSTOM_APP_BIN_OFFSET=0x10000
CONFIG_PARTITION_TABLE_FILENAME="partitions.csv"
CONFIG_ESP32_DEFAULT_CPU_FREQ_240=y
CONFIG_ESP32_DEFAULT_CPU_FREQ_MHZ=240
CONFIG_ESP32_SPIRAM_SUPPORT=y
CONFIG_SPIRAM_SIZE=-1
CONFIG_SPIRAM_SPEED_40M=y
CONFIG_NEWLIB_NANO_FORMAT=y
```
